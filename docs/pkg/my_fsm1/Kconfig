## docs/pkg/my_fsm1/Kconfig
```kconfig
# Kconfig file for package my_fsm1
menuconfig PKG_USING_MY_FSM1
    bool "A simple event-driven finite state machine."
    default n

if PKG_USING_MY_FSM1

    config PKG_MY_FSM1_PATH
        string
        default "/packages/system/my_fsm1"

    choice
        prompt "Version"
        default PKG_USING_MY_FSM1_LATEST_VERSION
        help
            Select the package version

        config PKG_USING_MY_FSM1_V100
            bool "v1.0.0"

        config PKG_USING_MY_FSM1_LATEST_VERSION
            bool "latest"
    endchoice

    config PKG_MY_FSM1_VER
       string
       default "v1.0.0"    if PKG_USING_MY_FSM1_V100
       default "latest"    if PKG_USING_MY_FSM1_LATEST_VERSION

endif
```
